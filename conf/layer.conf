## conf/layer.conf
```bitbake
# We have a conf and classes directory, add to BBPATH
BBPATH .= ":${LAYERDIR}"

# We have a recipes directory, add to BBFILES
BBFILES += "${LAYERDIR}/recipes-*/*/*.bb \
            ${LAYERDIR}/recipes-*/*/*.bbappend \
            "

BBFILE_COLLECTIONS += "openclovis"
BBFILE_PATTERN_openclovis := "^${LAYERDIR}/"
BBFILE_PRIORITY_openclovis = "9"

LAYERDEPENDS_openclovis = "core openembedded-layer networking-layer"
```
